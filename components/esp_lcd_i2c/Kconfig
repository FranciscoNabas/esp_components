## components/esp_lcd_i2c/Kconfig
```kconfig
menu "HD44780 LCD Display"
    config I2C_LCD_DEVICE_ADDRESS
        hex "I2C device address"
        default 0x27
        help
            The I2C address from the LCD module.

    config I2C_LCD_COLUMNS
        int "Number of columns"
        default 16
        range 0 100
        help
            The number of character columns.

    config I2C_LCD_ROWS
        int "Number of rows"
        default 2
        range 0 50
        help
            The number of lines.

    config I2C_LCD_SCL_GPIO
        int "SCL pin number"
        default -1
        help
            The GPIO number for the SCL pin.

    config I2C_LCD_SDA_GPIO
        int "SDA pin number"
        default -1
        help
            The GPIO number for the SDA pin.

    choice
        prompt "I2C bus clock Hertz"
        default I2C_LCD_CLK_400000

        config I2C_LCD_CLK_100000
            bool "100KHz (standard)"

        config I2C_LCD_CLK_400000
            bool "400KHz (fast mode)"

        config I2C_LCD_CLK_1000000
            bool "1MHz (fast mode plus)"
        
    endchoice
endmenu
```

## components/esp_rotary_encoder/Kconfig
```kconfig
menu "Rotary Encoder Configuration"
	config ROTARY_ENC_A_GPIO
		int "Pin A GPIO"
		default  -1
		help
			GPIO number of the pin A.

	config ROTARY_ENC_B_GPIO
		int "Pin B GPIO"
		default  -1
		help
			GPIO number of the pin B.

	config ROTARY_ENC_SW_GPIO
		int "Pin Switch GPIO"
		default  -1
		help
			GPIO number of the pin Switch.
endmenu
```

## components/esp_sht4x/Kconfig
```kconfig
menu "SHT4X Sensors"
    config SHT4X_SCL_GPIO
        int "SCL pin number"
        default -1
        help
            The GPIO number for the SCL pin.

    config SHT4X_SDA_GPIO
        int "SDA pin number"
        default -1
        help
            The GPIO number for the SDA pin.

    choice
        prompt "I2C bus clock Hertz"
        default SHT4X_CLK_100000

        config SHT4X_CLK_100000
            bool "100KHz (standard)"

        config SHT4X_CLK_400000
            bool "400KHz (fast mode)"

        config SHT4X_CLK_1000000
            bool "1MHz (fast mode plus)"
        
    endchoice
endmenu
```
